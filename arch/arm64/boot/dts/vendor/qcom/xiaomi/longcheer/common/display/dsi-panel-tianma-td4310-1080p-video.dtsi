// SPDX-License-Identifier: GPL-2.0
// Copyright (C) 2019 XiaoMi, Inc.

&mdss_mdp {
	dsi_td4310_tianma_fhd_video: qcom,mdss_dsi_td4310_tianma_fhd_video {
		qcom,mdss-dsi-panel-name = "tianma td4310 fhd video mode dsi panel";
		qcom,mdss-dsi-panel-controller = <&mdss_dsi0>;
		qcom,mdss-dsi-panel-type = "dsi_video_mode";
		qcom,mdss-dsi-panel-framerate = <60>;
		qcom,mdss-dsi-virtual-channel-id = <0>;
		qcom,mdss-dsi-stream = <0>;
		qcom,mdss-dsi-panel-width = <1080>;
		qcom,mdss-dsi-panel-height = <2160>;
		qcom,mdss-pan-physical-width-dimension = <68>;
		qcom,mdss-pan-physical-height-dimension = <136>;
		qcom,mdss-dsi-h-front-porch = <108>;
		qcom,mdss-dsi-h-back-porch = <60>;
		qcom,mdss-dsi-h-pulse-width = <12>;
		qcom,mdss-dsi-h-sync-skew = <0>;
		qcom,mdss-dsi-v-back-porch = <33>;
		qcom,mdss-dsi-v-front-porch = <6>;
		qcom,mdss-dsi-v-pulse-width = <4>;
		qcom,mdss-dsi-h-left-border = <0>;
		qcom,mdss-dsi-h-right-border = <0>;
		qcom,mdss-dsi-v-top-border = <0>;
		qcom,mdss-dsi-v-bottom-border = <0>;
		qcom,mdss-dsi-bpp = <24>;
		qcom,mdss-dsi-underflow-color = <0xff>;
		qcom,mdss-dsi-border-color = <0>;
		qcom,mdss-dsi-h-sync-pulse = <0>;
		qcom,mdss-dsi-traffic-mode = "burst_mode";
		qcom,mdss-dsi-bllp-eof-power-mode;
		qcom,mdss-dsi-bllp-power-mode;
		qcom,mdss-dsi-lane-0-state;
		qcom,mdss-dsi-lane-1-state;
		qcom,mdss-dsi-lane-2-state;
		qcom,mdss-dsi-lane-3-state;
		qcom,mdss-dsi-panel-timings = [
			e6 38 26 00 68 6e 2a
			3c 44 03 04 00
		];
		qcom,mdss-dsi-t-clk-post = <0x0e>;
		qcom,mdss-dsi-t-clk-pre = <0x35>;
		qcom,mdss-dsi-bl-min-level = <1>;
		qcom,mdss-dsi-bl-max-level = <4095>;
		qcom,mdss-dsi-dma-trigger = "trigger_sw";
		qcom,mdss-dsi-mdp-trigger = "none";
		qcom,ulps-enabled;
		qcom,panel-allow-phy-poweroff;
		qcom,mdss-dsi-on-command = [
			39 01 00 00 46 00 02 11 00
			29 01 00 00 00 00 02 B0 04
			29 01 00 00 00 00 02 D6 01
			29 01 00 00 00 00 02 ea 0a
			39 01 00 00 00 00 02 51 ff
			39 01 00 00 00 00 02 53 2c
			29 01 00 00 00 00 1A CE 55 40 56 6E 87 95 a0 b0 c0 c2 c9 ce df e3 e4 ec FF 04 00 00 04 46 04 69 5A
			39 01 00 00 00 00 02 55 00
			39 01 00 00 00 00 02 35 00
			39 01 00 00 14 00 02 29 00
		];
		qcom,mdss-dsi-off-command = [
			05 01 00 00 14 00 02 28 00
			05 01 00 00 78 00 02 10 00
		];
		qcom,mdss-dsi-pan-enable-dynamic-bitclk;
		qcom,mdss-dsi-dynamic-bitclk_freq = <798240576 801594528 804948480 808302432 811656384>;
		qcom,mdss-dsi-on-command-state = "dsi_lp_mode";
		qcom,mdss-dsi-off-command-state = "dsi_hs_mode";
		qcom,mdss-dsi-bl-pmic-control-type = "bl_ctrl_wled";
		qcom,mdss-dsi-reset-sequence = <1 1>, <0 5>, <1 35>;
		qcom,mdss-dsi-tx-eot-append;
		qcom,mdss-dsi-post-init-delay = <1>;
		/*qcom,esd-check-enabled;*/
		qcom,mdss-dsi-panel-status-command = [06 01 00 01 05 00 01 0A];
		qcom,mdss-dsi-panel-status-command-state = "dsi_hs_mode";
		qcom,mdss-dsi-panel-status-check-mode = "reg_read";
		qcom,mdss-dsi-panel-status-read-length = <1>;
		qcom,mdss-dsi-panel-status-value = <0x1c>;
		qcom,mdss-dsi-panel-max-error-count = <3>;
		qcom,panel-ack-disabled;
		qcom,partial-update-enabled = "single_roi";
		qcom,panel-roi-alignment = <540 270 270 270 1080 270>;
		cm,mdss-livedisplay-cabc-ui-cmd = [
			15 00 00 00 00 00 02 55 01
			29 00 00 00 00 00 08 B8 89 51 0d 00 02 00 00
			29 00 00 00 00 00 1A CE 55 40 4d 6a 75 97 a7 b6 c9 d0 d4 e7 e8 e9 f2 fb ff 04 00 00 04 46 04 69 5a
			29 01 00 00 00 00 0A F9 64 FF E0 BE 00 8D BF 80 00
		];
		cm,mdss-livedisplay-cabc-cmd = [15 01 00 00 00 00 02 55 00];
	};
};
