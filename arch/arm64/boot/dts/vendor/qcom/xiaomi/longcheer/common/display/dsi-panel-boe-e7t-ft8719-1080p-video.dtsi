// SPDX-License-Identifier: GPL-2.0
// Copyright (C) 2019 XiaoMi, Inc.

&mdss_mdp {
	dsi_ft8719_e7t_boe_fhdplus_video: qcom,mdss_dsi_ft8719_e7t_boe_fhdplus_video {
		qcom,mdss-dsi-panel-name = "boe ft8719 fhdplus video mode dsi panel";
		qcom,mdss-dsi-panel-controller = <&mdss_dsi0>;
		qcom,mdss-dsi-panel-type = "dsi_video_mode";
		qcom,mdss-dsi-panel-framerate = <60>;
		qcom,mdss-dsi-virtual-channel-id = <0>;
		qcom,mdss-dsi-stream = <0>;
		qcom,mdss-dsi-panel-width = <1080>;
		qcom,mdss-dsi-panel-height = <2280>;
		qcom,mdss-pan-physical-width-dimension = <68>;
		qcom,mdss-pan-physical-height-dimension = <143>;
		qcom,mdss-dsi-h-front-porch = <124>;
		qcom,mdss-dsi-h-back-porch = <60>;
		qcom,mdss-dsi-h-pulse-width = <4>;
		qcom,mdss-dsi-h-sync-skew = <0>;
		qcom,mdss-dsi-v-back-porch = <12>;
		qcom,mdss-dsi-v-front-porch = <115>;
		qcom,mdss-dsi-v-pulse-width = <4>;
		qcom,mdss-dsi-h-left-border = <0>;
		qcom,mdss-dsi-h-right-border = <0>;
		qcom,mdss-dsi-v-top-border = <0>;
		qcom,mdss-dsi-v-bottom-border = <0>;
		qcom,mdss-dsi-bpp = <24>;
		qcom,mdss-dsi-underflow-color = <0xff>;
		qcom,mdss-dsi-border-color = <0>;
		qcom,mdss-dsi-h-sync-pulse = <0>;
		qcom,mdss-dsi-traffic-mode = "burst_mode";
		qcom,mdss-dsi-bllp-eof-power-mode;
		qcom,mdss-dsi-bllp-power-mode;
		qcom,mdss-dsi-lane-0-state;
		qcom,mdss-dsi-lane-1-state;
		qcom,mdss-dsi-lane-2-state;
		qcom,mdss-dsi-lane-3-state;
		qcom,mdss-dsi-panel-timings = [
			fe 3c 2a 00 70 74 2e
			40 30 03 04 00
		];
		qcom,mdss-dsi-t-clk-post = <0x0f>;
		qcom,mdss-dsi-t-clk-pre = <0x37>;
		qcom,mdss-dsi-bl-min-level = <1>;
		qcom,mdss-dsi-bl-max-level = <4095>;
		qcom,mdss-brightness-max-level = <4095>;
		qcom,mdss-dsi-dma-trigger = "trigger_sw";
		qcom,mdss-dsi-mdp-trigger = "none";
		qcom,ulps-enabled;
		qcom,panel-allow-phy-poweroff;
		qcom,mdss-dsi-on-command = [
			39 00 00 00 00 00 02 00 00
			39 00 00 00 00 00 04 FF 87 19 01
			39 00 00 00 00 00 02 00 80
			39 00 00 00 00 00 03 FF 87 19
			39 00 00 00 00 00 02 00 80
			39 00 00 00 00 00 0d CA 82 80 80 80 80 80 80 80 80 80 80 80
			39 00 00 00 00 00 02 00 90
			39 00 00 00 00 00 0a CA fe ff 13 fc ff cc fA ff 66
			39 01 00 00 00 00 02 00 A0
			39 01 00 00 00 00 0d D6 75 74 80 80 80 80 80 80 80 80 80 80
			39 01 00 00 00 00 02 00 B0
			39 01 00 00 00 00 0d D6 84 80 80 80 80 80 80 80 80 80 80 80
			39 01 00 00 00 00 02 00 C0
			39 01 00 00 00 00 0d D6 7c 81 80 80 80 80 80 80 80 80 80 80
			39 01 00 00 00 00 02 00 D0
			39 01 00 00 00 00 0d D6 81 7e 80 80 80 80 80 80 80 80 80 80
			39 01 00 00 00 00 02 00 E0
			39 01 00 00 00 00 0d D6 8b 99 80 80 80 80 80 80 80 80 80 80
			39 01 00 00 00 00 02 00 F0
			39 01 00 00 00 00 0d D6 79 7b 80 80 80 80 80 80 80 80 80 80
			39 01 00 00 00 00 02 00 00
			39 01 00 00 00 00 0d D7 80 80 80 80 80 80 80 80 80 80 80 80
			39 01 00 00 00 00 02 00 10
			39 01 00 00 00 00 0d D7 80 80 80 80 80 80 80 80 80 80 80 80
			39 00 00 00 00 00 02 00 80
			39 00 00 00 00 00 0b D9 FD 01 06 00 FD 0F FA 0F E1 01
			39 00 00 00 00 00 02 00 90
			39 00 00 00 00 00 09 D9 0F 00 07 00 1C 00 7E 01
			39 00 00 00 00 00 02 00 00
			39 00 00 00 00 00 03 51 ff 0f
			39 00 00 00 00 00 02 53 2c
			39 00 00 00 00 00 02 55 00
			15 01 00 00 78 00 02 11 00
			15 01 00 00 14 00 02 29 00
		];
		qcom,mdss-dsi-off-command = [
			15 01 00 00 14 00 02 28 00
			15 01 00 00 78 00 02 10 00
			39 01 00 00 00 00 02 00 00
			39 01 00 00 00 00 05 f7 5a a5 95 27
		];
		qcom,mdss-dsi-pan-enable-dynamic-bitclk;
		qcom,mdss-dsi-dynamic-bitclk_freq = <798240576 801594528 804948480 808302432 811656384>;
		qcom,mdss-dsi-on-command-state = "dsi_lp_mode";
		qcom,mdss-dsi-off-command-state = "dsi_lp_mode";
		qcom,mdss-dsi-bl-pmic-control-type = "bl_ctrl_wled";
		qcom,mdss-dsi-reset-sequence = <1 4>, <0 1>, <1 11>;
		qcom,mdss-dsi-tx-eot-append;
		qcom,mdss-dsi-post-init-delay = <1>;
		/*qcom,esd-check-enabled;*/
		qcom,mdss-dsi-panel-status-command = [06 01 00 01 05 00 01 0A];
		qcom,mdss-dsi-panel-status-command-state = "dsi_hs_mode";
		qcom,mdss-dsi-panel-status-check-mode = "reg_read";
		qcom,mdss-dsi-panel-status-read-length = <1>;
		qcom,mdss-dsi-panel-status-value = <0x9c>;
		qcom,mdss-dsi-panel-max-error-count = <3>;
		qcom,panel-ack-disabled;
		qcom,partial-update-enabled = "single_roi";
		qcom,panel-roi-alignment = <540 270 270 270 1080 270>;
		cm,mdss-livedisplay-cabc-cmd = [39 01 00 00 00 00 02 55 00];
		cm,mdss-livedisplay-cabc-ui-value = <0x01>;
	};
};
