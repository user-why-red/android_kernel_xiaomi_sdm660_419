// SPDX-License-Identifier: GPL-2.0
// Copyright (C) 2019 XiaoMi, Inc.

&mdss_mdp {
	dsi_nt36672a_shenchao_fhdplus_video: qcom,mdss_dsi_nt36672a_shenchao_fhdplus_video {
		qcom,mdss-dsi-panel-name = "shenchao nt36672a fhdplus video mode dsi panel";
		qcom,mdss-dsi-panel-controller = <&mdss_dsi0>;
		qcom,mdss-dsi-panel-type = "dsi_video_mode";
		qcom,mdss-dsi-panel-framerate = <60>;
		qcom,mdss-dsi-virtual-channel-id = <0>;
		qcom,mdss-dsi-stream = <0>;
		qcom,mdss-dsi-panel-width = <1080>;
		qcom,mdss-dsi-panel-height = <2340>;
		qcom,mdss-pan-physical-width-dimension = <67>;
		qcom,mdss-pan-physical-height-dimension = <145>;
		qcom,mdss-dsi-h-front-porch = <90>;
		qcom,mdss-dsi-h-back-porch = <120>;
		qcom,mdss-dsi-h-pulse-width = <2>;
		qcom,mdss-dsi-h-sync-skew = <0>;
		qcom,mdss-dsi-v-back-porch = <8>;
		qcom,mdss-dsi-v-front-porch = <10>;
		qcom,mdss-dsi-v-pulse-width = <3>;
		qcom,mdss-dsi-h-left-border = <0>;
		qcom,mdss-dsi-h-right-border = <0>;
		qcom,mdss-dsi-v-top-border = <0>;
		qcom,mdss-dsi-v-bottom-border = <0>;
		qcom,mdss-dsi-bpp = <24>;
		qcom,mdss-dsi-underflow-color = <0xff>;
		qcom,mdss-dsi-border-color = <0>;
		qcom,mdss-dsi-h-sync-pulse = <0>;
		qcom,mdss-dsi-traffic-mode = "burst_mode";
		qcom,mdss-dsi-bllp-eof-power-mode;
		qcom,mdss-dsi-bllp-power-mode;
		qcom,mdss-dsi-lane-0-state;
		qcom,mdss-dsi-lane-1-state;
		qcom,mdss-dsi-lane-2-state;
		qcom,mdss-dsi-lane-3-state;
		qcom,mdss-dsi-panel-timings = [
			fe 3c 2a 00 70 74 2e
			40 30 03 04 00
		];
		qcom,mdss-dsi-t-clk-post = <0x0e>;
		qcom,mdss-dsi-t-clk-pre = <0x37>;
		qcom,mdss-dsi-bl-min-level = <1>;
		qcom,mdss-dsi-bl-max-level = <4095>;
		qcom,mdss-brightness-max-level = <4095>;
		qcom,mdss-dsi-dma-trigger = "trigger_sw";
		qcom,mdss-dsi-mdp-trigger = "none";
		qcom,ulps-enabled;
		qcom,panel-allow-phy-poweroff;
		qcom,mdss-dsi-on-command = [
			15 01 00 00 00 00 02 ff 25
			15 01 00 00 00 00 02 fb 01
			15 01 00 00 00 00 02 18 96
			15 01 00 00 00 00 02 05 04
			15 01 00 00 00 00 02 ff 27
			15 01 00 00 00 00 02 fb 01
			15 01 00 00 00 00 02 d9 10
			15 01 00 00 00 00 02 ff 24
			15 01 00 00 00 00 02 fb 01
			15 01 00 00 00 00 02 82 13
			15 01 00 00 00 00 02 84 31
			15 01 00 00 00 00 02 88 13
			15 01 00 00 00 00 02 8a 31
			15 01 00 00 00 00 02 8e e4
			15 01 00 00 00 00 02 8f 01
			15 01 00 00 00 00 02 90 80
			15 01 00 00 00 00 02 9d b0
			15 01 00 00 00 00 02 ff 26
			15 01 00 00 00 00 02 fb 01
			15 01 00 00 00 00 02 a9 12
			15 01 00 00 00 00 02 aa 10
			15 01 00 00 00 00 02 ae 8a
			15 01 00 00 00 00 02 1c fa
			15 01 00 00 00 00 02 ff 10
			15 01 00 00 00 00 02 b0 01
			05 01 00 00 46 00 02 11 00
			15 01 00 00 00 00 02 51 B8
			39 01 00 00 00 00 03 68 03 04
			15 01 00 00 00 00 02 53 2c
			15 01 00 00 00 00 02 55 00
			05 01 00 00 00 00 02 29 00
		];
		qcom,mdss-dsi-off-command = [
			15 01 00 00 14 00 02 28 00
			15 01 00 00 78 00 02 10 00
		];
		qcom,mdss-dsi-pan-enable-dynamic-bitclk;
		qcom,mdss-dsi-dynamic-bitclk_freq = <798240576 801594528 804948480 808302432 811656384>;
		qcom,mdss-dsi-on-command-state = "dsi_lp_mode";
		qcom,mdss-dsi-off-command-state = "dsi_hs_mode";
		qcom,mdss-dsi-bl-pmic-control-type = "bl_ctrl_wled";
		qcom,mdss-dsi-reset-sequence = <1 1>, <0 5>, <1 15>;
		qcom,mdss-dsi-tx-eot-append;
		qcom,mdss-dsi-post-init-delay = <1>;
		/*qcom,esd-check-enabled;*/
		qcom,mdss-dsi-panel-status-command = [06 01 00 01 05 00 01 0A];
		qcom,mdss-dsi-panel-status-command-state = "dsi_hs_mode";
		qcom,mdss-dsi-panel-status-check-mode = "reg_read";
		qcom,mdss-dsi-panel-status-read-length = <1>;
		qcom,mdss-dsi-panel-status-value = <0x9c>;
		qcom,mdss-dsi-panel-max-error-count = <3>;
		qcom,panel-ack-disabled;
		qcom,partial-update-enabled = "single_roi";
		qcom,panel-roi-alignment = <540 270 270 270 1080 270>;
	};
};
